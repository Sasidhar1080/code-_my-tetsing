#include <Adafruit_SH1106.h>
#include <Adafruit_GFX.h>


//define front,back,count varible
int F = 25;
int B = 26;
int count = 0;

//define oled pins
#define OLED_SDA 21
#define OLED_SCL 22

//ardfruit commands
Adafruit_SH1106 display(21, 22);

#define NUMFLAKES 10
#define XPOS 0
#define YPOS 1
#define DELTAY 2

#if (SH1106_LCDHEIGHT != 64)
#error("Height incorrect, please fix Adafruit_SH1106.h!");
#endif

//Define bit map of SCRC logo and IIITH logo
const unsigned char bitmap_scrc [] PROGMEM = {
0xff, 0xff, 0xff, 0xff, 0xff, 0xff, 0xff, 0xff, 0xff, 0xff, 0xff, 0xff, 0xff, 0xff, 0xff, 0xff,
0xff, 0xff, 0xff, 0xff, 0xff, 0xff, 0xff, 0xff, 0xff, 0xff, 0xff, 0xff, 0xff, 0xff, 0xff, 0xff,
0xff, 0xff, 0xff, 0xff, 0xff, 0xff, 0xff, 0xff, 0xff, 0xff, 0xff, 0xff, 0xff, 0xff, 0xff, 0xff,
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0xff, 0xff, 0xff, 0xff, 0xff, 0xff, 0xff, 0xff, 0xff, 0xff, 0xff, 0xff, 0xff, 0xff, 0xff, 0xff

};

const unsigned char iiith [] PROGMEM = {
0x00, 0x00, 0x00, 0x00, 0x00, 0x00, 0x00, 0x00, 0x00, 0x00, 0x00, 0x00, 0x00, 0x00, 0x00, 0x00, 
0x00, 0x00, 0x00, 0x00, 0x00, 0x00, 0x00, 0x00, 0x00, 0x00, 0x00, 0x00, 0x00, 0x00, 0x00, 0x00, 
0x00, 0x00, 0x00, 0x00, 0x00, 0x00, 0x00, 0x00, 0x20, 0x00, 0x00, 0x00, 0x00, 0x00, 0x00, 0x00, 
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0x00, 0x00, 0x00, 0x00, 0x00, 0x00, 0x00, 0x00, 0x00, 0x00, 0x00, 0x00, 0x00, 0x00, 0x00, 0x00
    };
void setup() {
  
pinMode(F,INPUT);
pinMode(B,INPUT);
pinMode(OLED_SDA, INPUT_PULLUP);           // set pin to input
pinMode(OLED_SCL, INPUT_PULLUP);           // set pin to input
Serial.begin(9600);
}

void loop() {

display.begin(SH1106_SWITCHCAPVCC, 0x3C);  // initialize with the I2C addr 0x3D (for the 128x64)
display.display();
delay(2000);

// count logic 
Serial.print("f = ");
Serial.println(analogRead(F));
Serial.print("b = ");
Serial.println(analogRead(B));

//Enter Count 
    if(analogRead(F)<1010)
    {
      for(int i=0;i<300;i++)
       {
          if(analogRead(B)<1010)
            {
              count++;
              Serial.println(count);
              break;
            }
        delay(1);
       }
    }
//Exit Count 
  else if(analogRead(B)<1010)
    {
      for(int i=0;i<300;i++)
       {
          if(analogRead(F)<1010)
            {
              count--;
              Serial.println(count);
              break;
            }
        delay(1);
       }
    }
////iiiit logo 
//display.clearDisplay();
//display.display();
//display.drawBitmap(0, 0,  iiith, 128, 64, WHITE);
//display.display();
//delay(1000);
//
//
//// display scrc logo
//display.clearDisplay();
//display.drawBitmap(0, 0, bitmap_scrc, 128, 64, WHITE);
//display.display();
//delay(1000);

//Display visitor count
display.clearDisplay();
display.setCursor(0,0);
display.fillRoundRect(0, 2, 128, 64, 8, WHITE);

display.setCursor(30,10);
display.setTextSize(2.5);
display.setTextColor(BLACK);
display.println("COUNT:");
     
display.setCursor(50,40);
display.setTextSize(2);
display.setTextColor(BLACK);
display.println(count);
display.display();

  
}
